/*
 * thumbdeck_right.overlay — RIGHT half = CENTRAL (default).
 * Pairs with the host over BLE and presents the whole keyboard; also the half
 * you plug into the host over USB-C for wired HID. Split role central is set in
 * Kconfig.defconfig. Uses logical columns 0..4 (no offset).
 */

#include "thumbdeck.dtsi"

/* split role: central */
