## firmware/zmk-config/config/boards/arm/thumbdeck/Kconfig.board
```kconfig
# SPDX-License-Identifier: Apache-2.0
# Copyright 2026 Eric Neuman

config BOARD_THUMBDECK
	bool "thumbdeck"
	depends on SOC_NRF52840_QIAA
```

## firmware/zmk-config/config/boards/arm/thumbdeck/Kconfig.defconfig
```kconfig
# SPDX-License-Identifier: Apache-2.0
# Copyright 2026 Eric Neuman

if BOARD_THUMBDECK

config BOARD
	default "thumbdeck"

config BT_CTLR
	default BT

config ZMK_KEYBOARD_NAME
	default "thumbdeck"

endif # BOARD_THUMBDECK
```

## firmware/zmk-config/config/west.yml
```yaml
# SPDX-License-Identifier: Apache-2.0
# Copyright 2026 Eric Neuman

manifest:
  remotes:
    - name: zmkfirmware
      url-base: https://github.com/zmkfirmware
  projects:
    - name: zmk
      remote: zmkfirmware
      revision: v0.3.0
      import: app/west.yml
  self:
    path: config
```

## firmware/zmk-modules/tmag5273_nub/Kconfig
```kconfig
# SPDX-License-Identifier: Apache-2.0
# Copyright 2026 Eric Neuman

config INPUT_TMAG5273_NUB
	bool "TMAG5273 hall-effect trackpoint nub input driver"
	default y
	depends on DT_HAS_THUMBDECK_TMAG5273_NUB_ENABLED
	depends on I2C
	depends on INPUT
	help
	  ThinkPad-style rate-control pointing from a TI TMAG5273 I2C 3D hall
	  sensor reading a magnet embedded in a printed flexure spring (Ploopy
	  Bean architecture, adapted). Each poll converts X/Y field deflection
	  from the boot-calibrated zero into relative pointer motion through a
	  quadratic response curve: cursor VELOCITY follows deflection angle, so
	  the thumb never lifts. Emits INPUT_EV_REL X/Y for zmk,input-listener.
```

## firmware/zmk-modules/tmag5273_nub/dts/bindings/input/thumbdeck,tmag5273-nub.yaml
```yaml
# SPDX-License-Identifier: Apache-2.0
# Copyright 2026 Eric Neuman

description: |
  TI TMAG5273 I2C 3D hall sensor used as a ThinkPad-style rate-control
  pointing nub (magnet in a printed flexure above the sensor; deflection
  angle maps to cursor velocity). Pair with a zmk,input-listener node.

compatible: "thumbdeck,tmag5273-nub"

include: i2c-device.yaml

properties:
  sampling-hz:
    type: int
    default: 100
    description: Poll rate while active, Hz.

  deadzone:
    type: int
    default: 100
    description: |
      Raw sensor LSB counts (at the +/-40 mT range, 1.2207 uT/LSB) the field
      must move from the boot-calibrated zero before the cursor moves. Covers
      flexure hysteresis and sensor noise.
      v0.26: 150 -> 100. The range change from +/-80 to +/-40 mT halved the
      microtesla value of a count, so the old 150 would have DOUBLED the
      physical deadband. 100 counts = 0.122 mT = 9.5 gf of thumb force = 31 um
      of cap motion, which is 2.8x the ~44 uT RMS noise floor at 8x averaging.
      The old figure also cited "MagSafe-ring ambient drift", which stopped
      existing in v0.25 when the ring was deleted (and was never more than a
      rounding error at ~90 mm anyway).

  gain-num:
    type: int
    default: 1
    description: Numerator of the quadratic velocity curve gain.

  gain-div:
    type: int
    default: 1054
    description: |
      Denominator of the quadratic velocity curve. Velocity in 1/256 px per
      poll = excess_counts^2 * gain-num / gain-div, clamped to max-out px.

      v0.26: 3500 -> 1054, targeting the cursor's 1200 px/s clamp at 150 gf of
      thumb force — the top of the TrackPoint IV specification's usable range.

      THIS NUMBER IS A BRACKET, NOT A MEASUREMENT. It depends on the printed
      flexure's stiffness, and that could not be pinned down analytically: how
      much of the spiral arm is actually free (rather than buried in the hub and
      the flange bore) is the dominant term, and it swings the honest answer
      from gain-div 615 to 1807. 1054 is the geometric mean. Across that bracket
      the curve spans:

           25 gf ->     8 ..    35 px/s
           50 gf ->    57 ..   191 px/s
          100 gf ->   289 ..   876 px/s
          150 gf ->   701 ..  1200 px/s

      TO CALIBRATE, measure rather than model. Hang 50/100/150 gf laterally off
      the cap, read cap-top deflection with a dial indicator, then:

          gain-div = (counts_at_150gf - deadzone)^2 / (max-out * 256)

      where counts_at_150gf is the raw delta the driver logs at that force.
      Aim for 350-600 um of cap travel at 150 gf; if the print is outside that,
      change NUB_ARM_T in deck3d.py (0.7/0.8/0.9 coupons) before touching this.

      Two more reasons to treat it as a first-article item, like the axis flips:
      printed arm stiffness varies with material, temperature and layer bonding,
      and the sensor is spec'd to +/-20 % sensitivity error, which this quadratic
      curve squares into +/-44 % of cursor speed.

  max-out:
    type: int
    default: 12
    description: Max pointer pixels emitted per poll (velocity clamp).

  calib-samples:
    type: int
    default: 32
    description: Samples averaged at boot to find the magnetic zero point.

  invert-x:
    type: boolean
    description: Flip the X axis.

  invert-y:
    type: boolean
    description: Flip the Y axis.

  swap-xy:
    type: boolean
    description: Swap the X and Y axes (mounting-rotation correction).
```
